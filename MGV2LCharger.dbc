VERSION ""

NS_ :

BS_:
BU_: MgChargerGen2 VCU
BO_ 803 Status: 8 MgChargerGen2

BO_ 663 BMS_Status: 8 VCU
   SG_ Mode : 15|8@0+ (1,0) [0|1] "" MgChargerGen2

BO_ 831 VCUMsg33F: 0 VCU
   SG_ V2L_Control : 56|8@1+ (1,0) [0|0] "" Vector__XXX

BO_ 667 VCUMsg29B: 0 VCU

BO_ 668 VCUMsg29C: 0 VCU

BO_ 814 VCUMsg32E: 0 VCU

BO_ 835 VCUMsg343: 0 VCU

BO_ 840 VCUMsg348: 0 VCU

BO_ 916 VCUMsg394: 0 VCU
   SG_ CurrentRequest : 15|8@0+ (1,0) [0|0] "Amps" Vector__XXX
   SG_ VoltageSetpoint : 39|16@0+ (1,0) [0|0] "V" Vector__XXX

BO_ 918 VCUMsg396: 0 VCU

BO_ 922 VCUMsg39A: 0 VCU

BO_ 923 VCUMsg39B: 0 VCU

BO_ 804 MgChargerGen2Msg324: 8 MgChargerGen2
   SG_ HV_Voltage : 15|16@0+ (0.02,0) [0|0] "V" Vector__XXX
   SG_ V2L_Present : 56|8@1+ (1,0) [0|0] "" Vector__XXX

BO_ 827 MgChargerGen2Msg33B: 0 MgChargerGen2
   SG_ CP_Duty : 6|7@0+ (1,0) [0|0] "%" Vector__XXX
   SG_ ChargeActive : 7|1@1+ (1,0) [0|0] "" Vector__XXX

BO_ 829 MgChargerGen2Msg33D: 0 MgChargerGen2

BO_ 927 MgChargerGen2Msg39F: 0 MgChargerGen2
   SG_ LV_Voltage : 15|8@0+ (0.125,0) [0|0] "" Vector__XXX
   SG_ LV_Amps : 39|8@0+ (1,0) [0|0] "" Vector__XXX

BO_ 930 MgChargerGen2Msg3A2: 0 MgChargerGen2

BO_ 932 MgChargerGen2Msg3A4: 0 MgChargerGen2

BO_ 951 MgChargerGen2Msg3B7: 0 MgChargerGen2

BO_ 1169 MgChargerGen2Msg491: 0 MgChargerGen2

BO_ 412 VCUMsg19C: 8 VCU
   SG_ DCDC_Control : 23|8@0+ (1,0) [0|0] "" Vector__XXX

BA_DEF_ BO_ "GenMsgBackgroundColor" STRING ;
BA_DEF_ BO_ "GenMsgForegroundColor" STRING ;
BA_DEF_ BO_ "filterlabeling" INT 0 0;
BA_DEF_ BO_ "filterlabeling" INT 0 0;
BA_DEF_DEF_ "GenMsgBackgroundColor" "#ffffff";
BA_DEF_DEF_ "GenMsgForegroundColor" "#000000";
BA_DEF_DEF_ "filterlabeling" 1;
CM_ SG_ 916 CurrentRequest "Not_Confirmed";
VAL_ 663 Mode 1 "Standby" 3 "Driving" 6 "AC_Charging" 7 "DCFC";
VAL_ 831 V2L_Control 70 "Off" 72 "On";
VAL_ 804 V2L_Present 0 "No_Adaptor" 123 "Adaptor_Detected";
VAL_ 827 ChargeActive 0 "Not_Charging" 1 "Charging";
VAL_ 412 DCDC_Control 6 "Off" 38 "No Description";
